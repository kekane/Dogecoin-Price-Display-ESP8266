#include <SPI.h>
#include <Wire.h>
#include <Adafruit_GFX.h>
#include <Adafruit_SSD1306.h>
#include <ESP8266WiFi.h>
#include <ESP8266HTTPClient.h>
#include <ArduinoJson.h>
#include "arduino_secrets.h"

#define SCREEN_WIDTH 128 // OLED display width, in pixels
#define SCREEN_HEIGHT 64 // OLED display height, in pixels

// Declaration for an SSD1306 display connected to I2C (SDA, SCL pins)
#define OLED_RESET     -1 // Reset pin # (or -1 if sharing Arduino reset pin)
#define SCREEN_ADDRESS 0x3D ///< See datasheet for Address; 0x3D for 128x64, 0x3C for 128x32
Adafruit_SSD1306 display(SCREEN_WIDTH, SCREEN_HEIGHT, &Wire, OLED_RESET);

#define LOGO_HEIGHT 60 // BRC logo height, in pixels
#define LOGO_WIDTH 60 // BRC logo width, in pixels

const char* ssid = SECRET_SSID;
const char* password = SECRET_PASS;

const char* host = "https://sochain.com//api/v2/get_price/DOGE/USD"; // JSON URL with DOGE info
const char* dogePrice;

static const unsigned char PROGMEM logo[] = // BRC logo bitmap code
{
0x0,0x0,0x0,0x0,0x0,0x0,0x0,0x0,
0x0,0x0,0x1,0xff,0xfc,0x0,0x0,0x0,
0x0,0x0,0xf,0xff,0xff,0x80,0x0,0x0,
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0x0,0x0,0x0,0x0,0x0,0x0,0x0,0x0
};

void setup() {
  Serial.begin(115200);

  // SSD1306_SWITCHCAPVCC = generate display voltage from 3.3V internally
  if(!display.begin(SSD1306_SWITCHCAPVCC, SCREEN_ADDRESS)) {
    Serial.println(F("SSD1306 allocation failed"));
    for(;;); // Don't proceed, loop forever
  }

  display.clearDisplay();
  display.drawBitmap( // Display BRC Logo
    (display.width()  - LOGO_WIDTH ) / 2,
    (display.height() - LOGO_HEIGHT) / 2,
    logo, LOGO_WIDTH, LOGO_HEIGHT, 1);
  display.display();
  delay(2000); // Pause for 2 seconds

  Serial.print("Connecting to ");
  Serial.println(ssid);

  WiFi.begin(ssid, password); // Connect to WiFi

  while (WiFi.status() != WL_CONNECTED) {
    delay(500);
    Serial.print(".");
  }

  Serial.println("");
  Serial.println("WiFi connected");
}

void loop() {
  WiFiClientSecure client;
  HTTPClient http;

  client.setInsecure();

  Serial.print("Request Link: ");
  Serial.println(host);

  http.begin(client, host); // Connect to JSON URL

  int httpCode = http.GET();            //Send the request
  String payload = http.getString();    //Get the response payload from server

  Serial.print("Response Code:"); //200 is OK
  Serial.println(httpCode);   //Print HTTP return code

  Serial.print("Returned data from Server:");
  Serial.println(payload);    //Print request response payload
  
  if(httpCode == 200)
  {
    // Allocate JsonBuffer
    // Use arduinojson.org/assistant to compute the capacity.
    const size_t capacity = 384;
    DynamicJsonDocument doc(capacity);
    Serial.println(doc.capacity());
  
   // Parse JSON object
    DeserializationError error = deserializeJson(doc, payload);
    if (error) {
      Serial.print("deserializeJson failed with code ");
      Serial.println(error.c_str());
      return;
    }
  
    // Decode JSON/Extract values
    Serial.println(F("Response:"));
    dogePrice = doc["data"]["prices"][0]["price"].as<char*>();
    Serial.println(dogePrice);
  }
  else
  {
    Serial.println("Error in response");
  }

  http.end();  //Close connection

  display.clearDisplay(); // Display current price of DOGE
  display.setTextSize(2);
  display.setTextColor(WHITE);
  display.setCursor(0, 0);
  display.println("Doge Price");

  display.setTextSize(1);
  display.setTextColor(WHITE);
  display.setCursor(0, 17);
  display.print("$");
  display.println(dogePrice);

  display.display();
  delay(5000);

  display.clearDisplay(); // Display BRC logo
  display.drawBitmap(
    (display.width()  - LOGO_WIDTH ) / 2,
    (display.height() - LOGO_HEIGHT) / 2,
    logo, LOGO_WIDTH, LOGO_HEIGHT, 1);
  display.display();
  delay(2000);
}
